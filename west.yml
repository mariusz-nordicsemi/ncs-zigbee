## west.yml
```yaml
# Copyright (c) 2024 Nordic Semiconductor ASA
# SPDX-License-Identifier: Apache-2.0

manifest:
  remotes:
    - name: ncs
      url-base: https://github.com/nrfconnect
    - name: AdamZelikNS
      url-base: https://github.com/AdamZelikNS

  projects:
    - name: nrf
      remote: AdamZelikNS
      repo-path: sdk-nrf
      revision: tst/radio_rx_end_rx_rdy_latency
      import: true
```
